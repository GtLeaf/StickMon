## firmware/amoled_1_75c/sdkconfig.defaults
```kconfig
CONFIG_IDF_TARGET_ESP32S3=y
CONFIG_ESP_DEFAULT_CPU_FREQ_MHZ_240=y
CONFIG_ESPTOOLPY_FLASHMODE_QIO=y
CONFIG_ESPTOOLPY_FLASHSIZE_32MB=y
CONFIG_SPIRAM=y
CONFIG_SPIRAM_MODE_OCT=y
CONFIG_SPIRAM_SPEED_80M=y
CONFIG_COMPILER_CXX_EXCEPTIONS=n
CONFIG_COMPILER_CXX_RTTI=n
CONFIG_LOG_DEFAULT_LEVEL_INFO=y
CONFIG_ESP_MAIN_TASK_STACK_SIZE=32768
CONFIG_PARTITION_TABLE_CUSTOM=y
CONFIG_PARTITION_TABLE_CUSTOM_FILENAME="partitions.csv"
CONFIG_PARTITION_TABLE_FILENAME="partitions.csv"
CONFIG_SPIFFS_MAX_PARTITIONS=3
CONFIG_SPIFFS_OBJ_NAME_LEN=64
CONFIG_STICKMON_CLAW_ENABLE=y
CONFIG_ESP_BOARD_DEV_DISPLAY_LCD_SUPPORT=n
CONFIG_ESP_BOARD_DEV_LCD_TOUCH_SUPPORT=n
CONFIG_ESP_BOARD_DEV_LCD_TOUCH_SUB_I2C_SUPPORT=n
CONFIG_ESP_BOARD_DEV_AUDIO_CODEC_SUPPORT=n
CONFIG_ESP_BOARD_DEV_CAMERA_SUPPORT=n
```

## firmware/amoled_1_75c/sdkconfig.defaults.claw
```kconfig
CONFIG_STICKMON_CLAW_ENABLE=y
CONFIG_HTTP_REUSE_ENABLE=n
CONFIG_APP_CLAW_ENABLE_CLI=n
CONFIG_APP_CLAW_SYSTEM_UI_ENABLE=n
CONFIG_APP_CLAW_CAP_FILES=n
CONFIG_APP_CLAW_CAP_MEMORY=y
CONFIG_APP_CLAW_MEMORY_MODE_LIGHTWEIGHT=y
CONFIG_APP_CLAW_CAP_EVENT_ROUTER=y
CONFIG_APP_CLAW_CAP_CORE=y
CONFIG_APP_CLAW_CAP_IM_QQ=n
CONFIG_APP_CLAW_CAP_IM_FEISHU=n
CONFIG_APP_CLAW_CAP_IM_TG=n
CONFIG_APP_CLAW_CAP_IM_WECHAT=y
CONFIG_APP_CLAW_CAP_IM_LOCAL=n
CONFIG_APP_CLAW_CAP_SCHEDULER=n
CONFIG_APP_CLAW_CAP_LUA=n
CONFIG_APP_CLAW_CAP_MCP_CLIENT=n
CONFIG_APP_CLAW_CAP_MCP_SERVER=n
CONFIG_APP_CLAW_CAP_SKILL_MGR=y
CONFIG_APP_CLAW_CAP_SYSTEM=n
CONFIG_APP_CLAW_CAP_LLM_INSPECT=n
CONFIG_APP_CLAW_CAP_HTTP_REQUEST=n
CONFIG_APP_CLAW_CAP_WEB_SEARCH=n
CONFIG_APP_CLAW_CAP_ROUTER_MGR=n
CONFIG_APP_CLAW_CAP_SESSION_MGR=n
CONFIG_APP_CLAW_CAP_AGENT_MGR=n
```

## firmware/amoled_1_8_v1/main/Kconfig.projbuild
```kconfig
config STICKMON_CLAW_ENABLE
    bool "Enable StickMon ESP-Claw bridge"
    default y

config ESP_BOARD_DEV_DISPLAY_LCD_SUPPORT
    bool
    default n

config ESP_BOARD_DEV_LCD_TOUCH_SUPPORT
    bool
    default n

config ESP_BOARD_DEV_LCD_TOUCH_SUB_I2C_SUPPORT
    bool
    default n

config ESP_BOARD_DEV_AUDIO_CODEC_SUPPORT
    bool
    default n

config ESP_BOARD_DEV_CAMERA_SUPPORT
    bool
    default n
```

## firmware/amoled_1_8_v1/sdkconfig.defaults.claw
```kconfig
CONFIG_STICKMON_CLAW_ENABLE=y
# TLS contexts use PSRAM so the setup portal does not exhaust internal RAM.
CONFIG_MBEDTLS_EXTERNAL_MEM_ALLOC=y
# CONFIG_MBEDTLS_INTERNAL_MEM_ALLOC is not set
CONFIG_HTTP_REUSE_ENABLE=n
CONFIG_APP_CLAW_ENABLE_CLI=n
CONFIG_APP_CLAW_SYSTEM_UI_ENABLE=n
CONFIG_APP_CLAW_CAP_FILES=n
CONFIG_APP_CLAW_CAP_MEMORY=y
CONFIG_APP_CLAW_MEMORY_MODE_LIGHTWEIGHT=y
CONFIG_APP_CLAW_CAP_EVENT_ROUTER=y
CONFIG_APP_CLAW_CAP_CORE=y
CONFIG_APP_CLAW_CAP_IM_QQ=n
CONFIG_APP_CLAW_CAP_IM_FEISHU=y
CONFIG_APP_CLAW_CAP_IM_TG=n
CONFIG_APP_CLAW_CAP_IM_WECHAT=y
CONFIG_APP_CLAW_CAP_IM_LOCAL=n
CONFIG_APP_CLAW_CAP_SCHEDULER=n
CONFIG_FATFS_LFN_HEAP=y
CONFIG_FATFS_LFN_NONE=n
CONFIG_APP_CLAW_CAP_LUA=n
CONFIG_APP_CLAW_CAP_MCP_CLIENT=n
CONFIG_APP_CLAW_CAP_MCP_SERVER=n
CONFIG_APP_CLAW_CAP_SKILL_MGR=y
CONFIG_APP_CLAW_CAP_SYSTEM=n
CONFIG_APP_CLAW_CAP_LLM_INSPECT=n
CONFIG_APP_CLAW_CAP_HTTP_REQUEST=n
CONFIG_APP_CLAW_CAP_WEB_SEARCH=n
CONFIG_APP_CLAW_CAP_ROUTER_MGR=n
CONFIG_APP_CLAW_CAP_SESSION_MGR=n
CONFIG_APP_CLAW_CAP_AGENT_MGR=n
```

## firmware/amoled_1_8_v2/sdkconfig.defaults
```kconfig
CONFIG_IDF_TARGET_ESP32S3=y
CONFIG_ESP_DEFAULT_CPU_FREQ_MHZ_240=y
CONFIG_ESPTOOLPY_FLASHMODE_QIO=y
CONFIG_ESPTOOLPY_FLASHSIZE_16MB=y
CONFIG_SPIRAM=y
CONFIG_SPIRAM_MODE_OCT=y
CONFIG_SPIRAM_SPEED_80M=y
CONFIG_COMPILER_CXX_EXCEPTIONS=n
CONFIG_COMPILER_CXX_RTTI=n
CONFIG_LOG_DEFAULT_LEVEL_INFO=y
CONFIG_ESP_MAIN_TASK_STACK_SIZE=12288
CONFIG_PARTITION_TABLE_CUSTOM=y
CONFIG_PARTITION_TABLE_CUSTOM_FILENAME="partitions.csv"
CONFIG_PARTITION_TABLE_FILENAME="partitions.csv"
CONFIG_SPIFFS_MAX_PARTITIONS=2
CONFIG_SPIFFS_OBJ_NAME_LEN=64
```

## firmware/common/components/app_claw/Kconfig
```kconfig
menu "StickMon ESP-Claw runtime"

config APP_CLAW_ENABLE_CLI
    bool "Enable App Claw CLI"
    default n

config APP_CLAW_SYSTEM_UI_ENABLE
    bool "Enable ESP-Claw system UI"
    default n

choice APP_CLAW_MEMORY_MODE
    prompt "App Claw memory mode"
    depends on APP_CLAW_CAP_MEMORY
    default APP_CLAW_MEMORY_MODE_LIGHTWEIGHT

config APP_CLAW_MEMORY_MODE_FULL
    bool "Structured memory"

config APP_CLAW_MEMORY_MODE_LIGHTWEIGHT
    bool "Lightweight memory"

endchoice

config APP_CLAW_CAP_FILES
    bool "Enable files capability"
    default n

config APP_CLAW_CAP_MEMORY
    bool "Enable memory"
    default y

config APP_CLAW_CAP_EVENT_ROUTER
    bool "Enable event router"
    default y

config APP_CLAW_CAP_CORE
    bool "Enable agent core"
    default y

config APP_CLAW_CAP_IM_QQ
    bool "Enable QQ"
    default n

config APP_CLAW_CAP_IM_FEISHU
    bool "Enable Feishu"
    default n

config APP_CLAW_CAP_IM_TG
    bool "Enable Telegram"
    select APP_CLAW_CAP_EVENT_ROUTER
    default y

config APP_CLAW_CAP_IM_WECHAT
    bool "Enable WeChat"
    default n

config APP_CLAW_CAP_IM_LOCAL
    bool "Enable local IM"
    default n

config APP_CLAW_CAP_SCHEDULER
    bool "Enable scheduler"
    default n

config APP_CLAW_CAP_LUA
    bool "Enable Lua"
    default n

config APP_CLAW_CAP_MCP_CLIENT
    bool "Enable MCP client"
    default n

config APP_CLAW_CAP_MCP_SERVER
    bool "Enable MCP server"
    default n

config APP_CLAW_CAP_SKILL_MGR
    bool "Enable skill manager"
    default y

config APP_CLAW_CAP_SYSTEM
    bool "Enable system capability"
    default n

config APP_CLAW_CAP_LLM_INSPECT
    bool "Enable LLM inspection"
    default n

config APP_CLAW_CAP_HTTP_REQUEST
    bool "Enable HTTP request capability"
    default n

config APP_CLAW_CAP_WEB_SEARCH
    bool "Enable web search"
    default n

config APP_CLAW_CAP_ROUTER_MGR
    bool "Enable router manager"
    default n

config APP_CLAW_CAP_SESSION_MGR
    bool "Enable session manager"
    default n

config APP_CLAW_CAP_AGENT_MGR
    bool "Enable agent manager"
    default n

endmenu
```

## firmware/ostb_3st/sdkconfig.defaults
```kconfig
CONFIG_IDF_TARGET_ESP32S3=y
CONFIG_ESP_DEFAULT_CPU_FREQ_MHZ_240=y
CONFIG_ESPTOOLPY_FLASHMODE_DIO=y
CONFIG_ESPTOOLPY_FLASHFREQ_80M=y
CONFIG_ESPTOOLPY_FLASHSIZE_16MB=y
CONFIG_SPIRAM=y
CONFIG_SPIRAM_MODE_OCT=y
CONFIG_SPIRAM_SPEED_80M=y
CONFIG_SPIRAM_MEMTEST=y
CONFIG_COMPILER_CXX_EXCEPTIONS=n
CONFIG_COMPILER_CXX_RTTI=n
CONFIG_ESP_MAIN_TASK_STACK_SIZE=16384
CONFIG_FREERTOS_HZ=1000
CONFIG_ESP_CONSOLE_USB_SERIAL_JTAG=y
CONFIG_PARTITION_TABLE_CUSTOM=y
CONFIG_PARTITION_TABLE_CUSTOM_FILENAME="partitions.csv"
CONFIG_SPIFFS_OBJ_NAME_LEN=64
CONFIG_CODEC_ES8311_SUPPORT=y
```
